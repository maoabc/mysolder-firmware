## boards/c210_g431/board.yml
```yaml
board:
  name: c210_g431
  full_name: "C210 G431 Custom Board"
  vendor: mao
  socs:
    - name: stm32g431xx
```

## boards/c210_v2_g431/Kconfig.c210_v2_g431
```kconfig
config BOARD_C210_V2_G431
    bool "C210 Soldering Iron STM32G431 board"
    select SOC_STM32G431XX
    default y

    
config PD_MAX_REQUESTED_VOLTAGE
    int "Maximum PD requested voltage (mV)"
    default 15000
    range 5000 20000
    help
      Maximum voltage this board will request from USB PD power supply.
      Typical values: 5V, 9V, 12V, 15V, 20V.



config MAX_DUTY_CYCLE
    int "Maximum PWM duty cycle (%)"
    default 50
    range 10 90
    help
      Power limit to protect hardware and prevent overheating.

config TIP_SAMPLING_PERIOD_MS
    int "Thermocouple sampling period (ms)"
    default 25
    range 10 200
    help
      Time between temperature samples. 25 ms ≈ 40 Hz (C210), 50 ms ≈ 20 Hz (T12).

config MOSFET_OFF_DELAY_US
    int "MOSFET off delay after PWM=0 (μs)"
    default 600
    range 100 5000
    help
      Ensures MOSFET is fully off before next sample or operation.

config PID_COMPUTE_INTERVAL_MS
    int "PID computation interval (ms)"
    default 25
    range 10 100
    help
      How often the PID controller updates the output.

config PID_KP_1000X
    int "PID proportional gain Kp (×1000)"
    default 5000
    range 1000 20000
    help
      Kp scaled by 1000. Example: 5000 means actual Kp = 5.000

config PID_KI_1000X
    int "PID integral gain Ki (×1000)"
    default 5
    range 0 5000
    help
      Ki scaled by 1000. Example: 5 means actual Ki = 0.005

config PID_KD_1000X
    int "PID derivative gain Kd (×1000)"
    default 10 
    range 0 5000
    help
      Kd scaled by 1000. Example: 10 means actual Kd = 0.010

config RUNNING_SETPOINT_C
    int "Running/working setpoint (°C)"
    default 250
    range 150 450
    help
      Target temperature when actively soldering.

config SLEEPING_SETPOINT_C
    int "Sleep/standby setpoint (°C)"
    default 130
    range 50 200
    help
      Lower temperature when iron is idle to save power and reduce wear.
```

## boards/c210_v2_g431/Kconfig.defconfig
```kconfig
if BOARD_C210_V2_G431

config ARM_MPU
    default y

config HW_STACK_PROTECTION
    default y

config FPU
    default y

config CLOCK_CONTROL
    default y

config GPIO
    default y

config SPI
    default y

config I2C
    default y

config SENSOR
    default y

config LIS2DW12
    default y

config ADC
    default y

config PWM
    default y

config COUNTER
    default y

endif # BOARD_C210_V2_G431
```

## boards/c210_v2_g431/board.yml
```yaml
board:
  name: c210_v2_g431
  full_name: "C210 V2 G431 Custom Board"
  vendor: mao
  socs:
    - name: stm32g431xx
```

## boards/c210_v2t_g431/board.yml
```yaml
board:
  name: c210_v2t_g431
  full_name: "C210 V2T G431 developer version"
  vendor: mao
  socs:
    - name: stm32g431xx
```

## boards/c245_g431/board.yml
```yaml
board:
  name: c245_g431
  full_name: "C245 G431 Custom Board"
  vendor: mao
  socs:
    - name: stm32g431xx
```

## boards/t12_g431/Kconfig.t12_g431
```kconfig
config BOARD_T12_G431
    bool "T12 Soldering Iron STM32G431 board"
	select SOC_STM32G431XX
    default y

config MAX_DUTY_CYCLE
    int "Maximum PWM duty cycle (%)"
    default 100
    range 20 100
    help
      Power limit to protect hardware and prevent overheating.

config TIP_SAMPLING_PERIOD_MS
    int "Thermocouple sampling period (ms)"
    default 50
    range 10 200
    help
      Time between temperature samples. 25 ms ≈ 40 Hz (C210), 50 ms ≈ 20 Hz (T12).

config MOSFET_OFF_DELAY_US
    int "MOSFET off delay after PWM=0 (μs)"
    default 2000
    range 100 5000
    help
      Ensures MOSFET is fully off before next sample or operation.

config PID_COMPUTE_INTERVAL_MS
    int "PID computation interval (ms)"
    default 50
    range 10 100
    help
      How often the PID controller updates the output.

config PID_KP_1000X
    int "PID proportional gain Kp (×1000)"
    default 6000
    range 1000 20000
    help
      Kp scaled by 1000. Example: 5000 means actual Kp = 5.000

config PID_KI_1000X
    int "PID integral gain Ki (×1000)"
    default 0
    range 0 5000
    help
      Ki scaled by 1000. Example: 5 means actual Ki = 0.005

config PID_KD_1000X
    int "PID derivative gain Kd (×1000)"
    default 0 
    range 0 5000
    help
      Kd scaled by 1000. Example: 10 means actual Kd = 0.010

config RUNNING_SETPOINT_C
    int "Running/working setpoint (°C)"
    default 270
    range 150 450
    help
      Target temperature when actively soldering.

config SLEEPING_SETPOINT_C
    int "Sleep/standby setpoint (°C)"
    default 170
    range 50 200
    help
      Lower temperature when iron is idle to save power and reduce wear.
```

## boards/t12_g431/board.yml
```yaml
board:
  name: t12_g431
  full_name: "T12 G431 Custom Board"
  vendor: mao
  socs:
    - name: stm32g431xx
```
